## apps/examples/board_specific_demo/ameba_wifi_nat_demo/Kconfig
```kconfig
#
# For a description of the syntax of this configuration file,
# see kconfig-language at https://www.kernel.org/doc/Documentation/kbuild/kconfig-language.txt
#

config EXAMPLES_WIFINAT
	bool "WIFI NAT example"
	default n
	---help---
		Enable WIFI NAT Example

config USER_ENTRYPOINT
	string
	default "wifinat" if ENTRY_WIFINAT
```
